// *****************************************************************************
//  概要
//    : パネル制御クラスのソースファイルです。
//  備考
//    : 25ms周期前提
//  ---------------------------------------------------------------------------
//  No   : 日時      : 内容
//  ---------------------------------------------------------------------------
//  1    :2024/08/16 : 初版
// *****************************************************************************

// *****************************************************************************
// ■ インクルード
// *****************************************************************************
#include "Panel.h"

// *****************************************************************************
// ■ グローバル変数
// *****************************************************************************
Button readButton(READ_BUTTON_PIN);

// *****************************************************************************
// ■ クラス
// *****************************************************************************

//-----------------------------------------
// 関数名　： Button
// 引数　　： ピン
// 戻値　　： -
// 備考　　：
//-----------------------------------------
Button::Button(int pin)
{
    this->pinNo = pin;
    this->OnTime = 0;
    pinMode(this->pinNo, INPUT);
}

//-----------------------------------------
// 関数名　： Read
// 引数　　： -
// 戻値　　： -
// 備考　　：
//-----------------------------------------
void Button::Read()
{
    int state = digitalRead(this->pinNo);

    if(state)
        this->OnTime++;
    else
        this->OnTime = 0;
}

//-----------------------------------------
// 関数名　： PanelController
// 引数　　： -
// 戻値　　： -
// 備考　　：
//-----------------------------------------
PanelController::PanelController()
{
    this->ReadButton = &readButton;
}

//-----------------------------------------
// 関数名　： Initialize
// 引数　　： -
// 戻値　　： -
// 備考　　：
//-----------------------------------------
void PanelController::Initialize()
{
    this->Time.MilliSecond = App.Time.MilliSecond;
}

//-----------------------------------------
// 関数名　： MainProcess
// 引数　　： -
// 戻値　　： -
// 備考　　：
//-----------------------------------------
void PanelController::MainProcess()
{
    if(this->getIsTiming())
    {
        this->updateButtons();

        // demo
        if(this->ReadButton->OnTime == 1)
        {
            Serial.println("button on");
        }
    }
}

//-----------------------------------------
// 関数名　： getIsTiming
// 引数　　： -
// 戻値　　： ON=更新タイミング
// 備考　　： 更新周期か判定します。
//-----------------------------------------
char PanelController::getIsTiming()
{
    if((App.Time.MilliSecond - this->Time.MilliSecond) >= INTERVAL_TIME)
    {
        this->Time.MilliSecond = App.Time.MilliSecond;
        return ON;
    }
    return OFF;
}

//-----------------------------------------
// 関数名　： updateButtons
// 引数　　： -
// 戻値　　： -
// 備考　　： ボタンを更新します。
//-----------------------------------------
void PanelController::updateButtons()
{
    this->ReadButton->Read();
}